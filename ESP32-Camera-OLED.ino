#include "esp_camera.h"
#include <WiFi.h>
#include <GyverOLED.h>
GyverOLED<SSD1306_128x64, OLED_NO_BUFFER> oled;
//
// WARNING!!! PSRAM IC required for UXGA resolution and high JPEG quality
//            Ensure ESP32 Wrover Module or other board with PSRAM is selected
//            Partial images will be transmitted if image exceeds buffer size
//

// Select camera model
//#define CAMERA_MODEL_WROVER_KIT // Has PSRAM
//#define CAMERA_MODEL_ESP_EYE // Has PSRAM
//#define CAMERA_MODEL_M5STACK_PSRAM // Has PSRAM
//#define CAMERA_MODEL_M5STACK_V2_PSRAM // M5Camera version B Has PSRAM
//#define CAMERA_MODEL_M5STACK_WIDE // Has PSRAM
//#define CAMERA_MODEL_M5STACK_ESP32CAM // No PSRAM
#define CAMERA_MODEL_AI_THINKER // Has PSRAM
//#define CAMERA_MODEL_TTGO_T_JOURNAL // No PSRAM

#include "camera_pins.h"

const char* ssid = "WiFi-name";
const char* password = "password";

const uint8_t Apple_logo_24x32[] PROGMEM = {
	0x00, 0x00, 0x00, 0x00, 0x00, 0x00, 0x00, 0x00, 0x3C, 0x3C, 0x0F, 0x0F, 0x03, 0x03, 0x00, 0x00, 0x00, 0x00, 0x00, 0x00, 0x00, 0x00, 0x00, 0x00, 
	0xFC, 0xFC, 0xFF, 0xFF, 0xFF, 0xFF, 0xFF, 0xFF, 0xFC, 0xFC, 0xFF, 0xFF, 0xFF, 0xFF, 0x0F, 0x0F, 0x0C, 0x0C, 0x00, 0x00, 0x00, 0x00, 0x00, 0x00, 
	0x3F, 0x3F, 0xFF, 0xFF, 0xFF, 0xFF, 0xFF, 0xFF, 0xFF, 0xFF, 0xFF, 0xFF, 0xFF, 0xFF, 0xFC, 0xFC, 0x3C, 0x3C, 0x00, 0x00, 0x00, 0x00, 0x00, 0x00, 
	0x00, 0x00, 0x00, 0x00, 0x03, 0x03, 0x03, 0x03, 0x00, 0x00, 0x03, 0x03, 0x03, 0x03, 0x00, 0x00, 0x00, 0x00, 0x00, 0x00, 0x00, 0x00, 0x00, 0x00, 
};

const uint8_t UNO_logo_24x24[] PROGMEM = {
	0x00, 0x00, 0x00, 0xC0, 0xF0, 0xF0, 0x78, 0x38, 0x38, 0x78, 0xF8, 0xF8, 0xF8, 0xF8, 0x78, 0x38, 0x38, 0x78, 0xF0, 0xF0, 0xC0, 0x00, 0x00, 0x00, 
	0x00, 0x00, 0x00, 0xFF, 0xFF, 0xFF, 0x80, 0x00, 0x00, 0x00, 0x1F, 0x3F, 0x3F, 0x1F, 0x00, 0x00, 0x00, 0x80, 0xFF, 0xFF, 0xFF, 0x00, 0x00, 0x00, 
	0x00, 0x00, 0x00, 0x03, 0x0F, 0x0F, 0x1F, 0x1E, 0x1E, 0x1C, 0x1C, 0x1C, 0x1C, 0x1C, 0x1C, 0x1E, 0x1E, 0x1F, 0x0F, 0x0F, 0x03, 0x00, 0x00, 0x00, 
};

const uint8_t Apple_logo_mini_8x8[] PROGMEM = {
	0x3C, 0x7C, 0x38, 0x7D, 0x24, 0x00, 0x00, 0x00, 
};

const uint8_t UNO_logo_mini_8x8[] PROGMEM = {
	0x7E, 0xC1, 0x81, 0x9F, 0x9F, 0x81, 0xC1, 0x7E, 
};

const uint8_t Window_84x46[] PROGMEM = {
	0xF8, 0x46, 0x42, 0x41, 0x5D, 0x49, 0x5D, 0x41, 0x41, 0x41, 0x41, 0x41,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 0xF8, 
	0xFF, 0x00, 0x00, 0x00, 0x00, 0x00, 0x00, 0x00, 0x00, 0x00, 0x00, 0x00,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 0xFF, 
	0xFF, 0x00, 0x00, 0x00, 0x00, 0x00, 0x00, 0x00, 0x00, 0x00, 0x00, 0x00,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 0xFF, 
	0xFF, 0x00, 0x00, 0x00, 0x00, 0x00, 0x00, 0x00, 0x00, 0x00, 0x00, 0x00,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 0xFF, 
	0xFF, 0x00, 0x00, 0x00, 0x00, 0x00, 0x00, 0x00, 0x00, 0x00, 0x00, 0x00,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 0xFF, 
	0x07, 0x18, 0x10, 0x20, 0x20, 0x20, 0x20, 0x20, 0x20, 0x20, 0x20, 0x20,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 0x07, 
};

void startCameraServer();

void setup() {
  oled.init(14, 15);
  oled.clear();
  oled.drawBitmap(52, 15, UNO_logo_24x24, 24, 24, BITMAP_NORMAL, BUF_ADD);
  oled.roundRect(45, 44, 82, 50, OLED_STROKE);  
  delay(500);
  //oled.roundRect(45, 44, 51, 50);
  //oled.rect(48, 44, 51, 50);
  oled.fastLineV(45, 46, 48);
  delay(50);
  oled.fastLineV(46, 45, 49);
  delay(50);
  for (int i=0; i <= 33; i++){
    //oled.roundRect(45, 44, 82, 50, OLED_STROKE);
    //oled.rect(49+(i*4), 44, 55+(i*4), 50);
    oled.fastLineV(47+i, 44, 50);
    delay(50);
   }
  oled.fastLineV(81, 45, 49);
  delay(50);   
  oled.fastLineV(82, 46, 48);
  delay(500);

  Serial.begin(115200);
  Serial.setDebugOutput(true);
  Serial.println();

  camera_config_t config;
  config.ledc_channel = LEDC_CHANNEL_0;
  config.ledc_timer = LEDC_TIMER_0;
  config.pin_d0 = Y2_GPIO_NUM;
  config.pin_d1 = Y3_GPIO_NUM;
  config.pin_d2 = Y4_GPIO_NUM;
  config.pin_d3 = Y5_GPIO_NUM;
  config.pin_d4 = Y6_GPIO_NUM;
  config.pin_d5 = Y7_GPIO_NUM;
  config.pin_d6 = Y8_GPIO_NUM;
  config.pin_d7 = Y9_GPIO_NUM;
  config.pin_xclk = XCLK_GPIO_NUM;
  config.pin_pclk = PCLK_GPIO_NUM;
  config.pin_vsync = VSYNC_GPIO_NUM;
  config.pin_href = HREF_GPIO_NUM;
  config.pin_sscb_sda = SIOD_GPIO_NUM;
  config.pin_sscb_scl = SIOC_GPIO_NUM;
  config.pin_pwdn = PWDN_GPIO_NUM;
  config.pin_reset = RESET_GPIO_NUM;
  config.xclk_freq_hz = 20000000;
  config.pixel_format = PIXFORMAT_JPEG;
  
  // if PSRAM IC present, init with UXGA resolution and higher JPEG quality
  //                      for larger pre-allocated frame buffer.
  if(psramFound()){
    config.frame_size = FRAMESIZE_UXGA;
    config.jpeg_quality = 10;
    config.fb_count = 2;
  } else {
    config.frame_size = FRAMESIZE_SVGA;
    config.jpeg_quality = 12;
    config.fb_count = 1;
  }

#if defined(CAMERA_MODEL_ESP_EYE)
  pinMode(13, INPUT_PULLUP);
  pinMode(14, INPUT_PULLUP);
#endif

  // camera init
  esp_err_t err = esp_camera_init(&config);
  if (err != ESP_OK) {
    Serial.printf("Camera init failed with error 0x%x", err);
    return;
  }

  sensor_t * s = esp_camera_sensor_get();
  // initial sensors are flipped vertically and colors are a bit saturated
  if (s->id.PID == OV3660_PID) {
    s->set_vflip(s, 1); // flip it back
    s->set_brightness(s, 1); // up the brightness just a bit
    s->set_saturation(s, -2); // lower the saturation
  }
  // drop down frame size for higher initial frame rate
  s->set_framesize(s, FRAMESIZE_QVGA);

#if defined(CAMERA_MODEL_M5STACK_WIDE) || defined(CAMERA_MODEL_M5STACK_ESP32CAM)
  s->set_vflip(s, 1);
  s->set_hmirror(s, 1);
#endif

  WiFi.begin(ssid, password);

  oled.clear(); 
  oled.drawBitmap(2, 0, UNO_logo_mini_8x8, 8, 8, BITMAP_NORMAL, BUF_ADD);
  oled.fastLineH(10, 0, 128);
  oled.setCursorXY(15, 0);
  oled.setScale(1); 
  oled.print("Настройте роутер"); 
  delay(500);
  oled.roundRect(35, 30, 65, 45, OLED_STROKE);
  delay(50);
  oled.clear(35, 30, 65, 45);
  oled.roundRect(20, 20, 75, 55, OLED_STROKE);
  delay(50);
  oled.clear(20, 20, 75, 55);
  oled.drawBitmap(5, 18, Window_84x46, 84, 46, BITMAP_NORMAL, BUF_ADD);
  oled.setCursorXY(11, 33);
  oled.print("Имя:"); 
  oled.print(ssid); 
  oled.setCursorXY(11, 48);
  oled.print("Прл:"); 
  oled.print(password); 


  while (WiFi.status() != WL_CONNECTED) {
    delay(500);
    Serial.print(".");
  }

  oled.clear(15, 0, 128, 7);
  oled.setCursorXY(15, 0); 
  oled.print("Подключитесь"); 
  delay(500);
  oled.clear(0, 16, 128, 64); 

  Serial.println("");
  Serial.println("WiFi connected");

  startCameraServer();

  oled.setCursor(0, 2); 
  oled.println("Перейдите по ссылке:"); 
  oled.print("http://");
  oled.print(WiFi.localIP());
  oled.setCursor(0, 5); 
  oled.println("При ошибке в браузере");
  oled.println("мобильного устройства");
  oled.println("откройте ПК версию");

  Serial.print("Camera Ready! Use 'http://");
  Serial.print(WiFi.localIP());
  Serial.println("' to connect");
}

void loop() {
  // put your main code here, to run repeatedly:
  delay(10000);
}
